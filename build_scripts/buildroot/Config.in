## build_scripts/buildroot/Config.in
```kconfig
source "$BR2_EXTERNAL_PELLCORP_PATH/package/ustreamer/Config.in"
source "$BR2_EXTERNAL_PELLCORP_PATH/package/python-configupdater/Config.in"
source "$BR2_EXTERNAL_PELLCORP_PATH/package/klipper-flasher/Config.in"
```

## build_scripts/buildroot/package/python-configupdater/Config.in
```kconfig
config BR2_PACKAGE_PYTHON_CONFIGUPDATER
    bool "python-configupdater"
    help
      Config helper for updating klipper and moonraker config files
```
